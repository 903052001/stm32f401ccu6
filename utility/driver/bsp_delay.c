/*<FH+>************************************************************************/
/*                                                                            */
/* 版权所有: Copyright (C) 烽鸟出行. 2019. All rights reserved.               */
/*                                                                            */
/* 文件名称: bsp_delay.c                                                      */
/* 内容摘要: 利用systick实现精准延时函数                                     */
/* 其它说明: 无                                                               */
/* 当前版本: v 1.0.0                                                          */
/* 作    者: Leonard                                                          */
/* 完成日期: 2020-07-28                                                       */
/* 修改记录:                                                                  */
/*     修改日期          版本号     修改人          修改内容                 */
/* -------------------------------------------------------------------------- */
/*     2020-07-28        v 1.0.0     Leonard         创建文件                 */
/*<FH->************************************************************************/

/******************************************************************************/
/*               #include(依次为标准库头文件、非标准库头文件)                */
/******************************************************************************/
#include "stm32f4xx.h"
#include "bsp_delay.h"

/******************************************************************************/
/*                                外部引用声明                                */
/******************************************************************************/


/******************************************************************************/
/*                                 内部宏定义                                 */
/******************************************************************************/


/******************************************************************************/
/*                              内部数据类型定义                             */
/******************************************************************************/


/******************************************************************************/
/*                                内部函数原型                                */
/******************************************************************************/


/******************************************************************************/
/*                               全局(静态)变量                               */
/******************************************************************************/
static unsigned int  fac_us = 0;       /* us延时倍乘数  */
static unsigned int  fac_ms = 0;       /* ms延时倍乘数  */

/******************************************************************************/
/*                                内部函数实现                               */
/******************************************************************************/


/******************************************************************************/
/*                                全局函数实现                                */
/******************************************************************************/
/*<FUNC+>**********************************************************************/
/* 函数名称: bsp_delay_init                                                   */
/* 功能描述: 初始化延时函数                                                  */
/* 输入参数: SYSCLK --- 系统时钟频率(xMHz)                                   */
/* 输出参数: 无                                                               */
/* 返 回 值: void                                                             */
/* 操作流程:                                                                  */
/* 其它说明: 选择外部时钟即选择AHB的8分频                                    */
/* 修改记录:                                                                  */
/* -------------------------------------------------------------------------- */
/*     2020-07-28              v 1.0.0       Leonard       创建函数           */
/*<FUNC->**********************************************************************/
void bsp_delay_init(int SYSCLK)
{
    /* systick时钟源采用外部时钟,即AHB的8分频 */
    HAL_SYSTICK_CLKSourceConfig(SYSTICK_CLKSOURCE_HCLK_DIV8); 
  
    /* 8分频即9M下计9个数用1us */
    fac_us = SYSCLK / 8;    
    fac_ms = fac_us * 1000;   
    
    return;
}    

/*<FUNC+>**********************************************************************/
/* 函数名称: bsp_delay_us                                                     */
/* 功能描述: us 延时基准函数接口                                              */
/* 输入参数: nus --- 延时的us数                                               */
/* 输出参数: 无                                                               */
/* 返 回 值: void                                                             */
/* 操作流程:                                                                  */
/* 其它说明: SysTick->LOAD为24bit                                             */
/* 修改记录:                                                                  */
/* -------------------------------------------------------------------------- */
/*     2020-07-28              v 1.0.0       Leonard       创建函数           */
/*<FUNC->**********************************************************************/
void bsp_delay_us(int nus)
{   
    unsigned int temp = 0;   
    
    SysTick->LOAD  = (nus * fac_us) & 0xFFFFFF;    
    SysTick->VAL   = 0x00;          
    SysTick->CTRL |= SysTick_CTRL_ENABLE_Msk;   /* open */ 
    do
    {
        temp = SysTick->CTRL;
    }while((temp&0x01)&&(!(temp&(1<<16))));     
    SysTick->CTRL &= ~SysTick_CTRL_ENABLE_Msk;  /* close */ 
    SysTick->VAL   = 0x00; 
    
    return;
}

/*<FUNC+>**********************************************************************/
/* 函数名称: bsp_delay_ms                                                     */
/* 功能描述: ms 延时基准函数接口                                              */
/* 输入参数: nms --- 延时的ms数                                               */
/* 输出参数: 无                                                               */
/* 返 回 值: void                                                             */
/* 操作流程:                                                                  */
/* 其它说明: nms <= (0xffffff*8*1000/SYSCLK == 1864)                          */
/* 修改记录:                                                                  */
/* -------------------------------------------------------------------------- */
/*     2020-07-28              v 1.0.0       Leonard       创建函数           */
/*<FUNC->**********************************************************************/
void bsp_delay_ms(int nms)
{
    unsigned int temp = 0;   
    
    SysTick->LOAD  = (nms * fac_ms) & 0xFFFFFF;
    SysTick->VAL   = 0x00;          
    SysTick->CTRL |= SysTick_CTRL_ENABLE_Msk;
    do
    {
        temp = SysTick->CTRL;
    }while((temp&0x01)&&(!(temp&(1<<16))));  
    SysTick->CTRL &= ~SysTick_CTRL_ENABLE_Msk;
    SysTick->VAL   = 0x00;   

    return;
} 

/*<FUNC+>**********************************************************************/
/* 函数名称: bsp_delay_s                                                      */
/* 功能描述: s 延时基准函数接口                                              */
/* 输入参数: ns --- 延时的s数                                                */
/* 输出参数: 无                                                               */
/* 返 回 值: void                                                             */
/* 操作流程:                                                                  */
/* 其它说明: 无                                                               */
/* 修改记录:                                                                  */
/* -------------------------------------------------------------------------- */
/*     2020-07-28              v 1.0.0       Leonard       创建函数           */
/*<FUNC->**********************************************************************/
void bsp_delay_s(int ns)
{
    while(ns--)
    {
        bsp_delay_ms(1000);
    }

    return;
}

/*<FUNC+>**********************************************************************/
/* 函数名称: delay_us                                                         */
/* 功能描述: 微秒级精准延时                                                   */
/* 输入参数: nus --- 微秒延时数                                               */
/* 输出参数: 无                                                               */
/* 返 回 值: static void                                                      */
/* 操作流程:                                                                  */
/* 其它说明: 默认Systick时钟为系统时钟即未分频的主频(84MHz)                  */
/* 修改记录:                                                                  */
/* -------------------------------------------------------------------------- */
/*     2020-07-28              v 1.0.0       Leonard       创建函数           */
/*<FUNC->**********************************************************************/
void delay_us(int nus)
{
    unsigned int ticks, _1us;
    unsigned int told, tnow, tcnt = 0;
    unsigned int reload = SysTick->LOAD + 1;

    _1us  = reload / (1000 * HAL_TICK_FREQ_DEFAULT);
    ticks = _1us * nus;
    told  = SysTick->VAL;

    while (1)
    {
        tnow = SysTick->VAL;

        if (tnow != told)
        {
            tcnt += (tnow < told) ? (told - tnow) : (reload - tnow + told);

            told = tnow;

            if (tcnt >= ticks)
            {
                break;
            }
        }
    }

    return;
}

/*<FUNC+>**********************************************************************/
/* 函数名称: BSP_ResetSystem                                                  */
/* 功能描述: 系统复位                                                         */
/* 输入参数: 无                                                               */
/* 输出参数: 无                                                               */
/* 返 回 值: void                                                             */
/* 操作流程:                                                                  */
/* 其它说明: 无                                                               */
/* 修改记录:                                                                  */
/* -------------------------------------------------------------------------- */
/*     2020-07-28              v 1.0.0       Leonard       创建函数           */
/*<FUNC->**********************************************************************/
void BSP_ResetSystem(void)
{
    /* 关闭所有中断 */
    __set_FAULTMASK(1); 
    /* 复位 */
    NVIC_SystemReset();  
}
